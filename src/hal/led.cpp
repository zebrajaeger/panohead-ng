#include "led.h"

//------------------------------------------------------------------------------
Led::Led()
    : io_(NULL),
      pin_(0),
      timer_("Led")
//------------------------------------------------------------------------------
{
  timer_.onTimer([this] { toggle(); });
}

//------------------------------------------------------------------------------
bool Led::begin(DigitalIO *io, uint8_t pin, float blinkSpeedHz)
//------------------------------------------------------------------------------
{
  io_ = io;
  pin_ = pin;
  blinkSpeedHz_ = blinkSpeedHz;
  return true;
}

//------------------------------------------------------------------------------
void Led::loop()
//------------------------------------------------------------------------------
{
  timer_.loop();
}

//------------------------------------------------------------------------------
void Led::set(bool state)
//------------------------------------------------------------------------------
{
  if (io_) {
    io_->set(pin_, state);
  }
  timer_.stop();
}

//------------------------------------------------------------------------------
void Led::toggle()
//------------------------------------------------------------------------------
{
  if (io_) {
    io_->toggle(pin_);
  }
}

//------------------------------------------------------------------------------
void Led::blink()
//------------------------------------------------------------------------------
{
  timer_.startUs(getPeriodUs(), false, true);
}

//------------------------------------------------------------------------------
void Led::setBlinkSpeed(float speedHz)
//------------------------------------------------------------------------------
{
  blinkSpeedHz_ = speedHz;
  if (timer_.isRunning()) {
    blink();
  }
}

//------------------------------------------------------------------------------
void Led::blink(float speedHz)
//------------------------------------------------------------------------------
{
  blinkSpeedHz_ = speedHz;
  blink();
}

//------------------------------------------------------------------------------
uint64_t Led::getPeriodUs()
//------------------------------------------------------------------------------
{
  return 500000.0 / blinkSpeedHz_;
}